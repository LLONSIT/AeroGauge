SECTIONS
{
    __romPos = 0;
    _gp = 0x0;
    header_ROM_START = __romPos;
    header_VRAM = ADDR(.header);
    .header : AT(header_ROM_START) SUBALIGN(16)
    {
        header_DATA_START = .;
        header_s = .;
        build/asm/header.o(.data);
        header_DATA_END = .;
        header_DATA_SIZE = ABSOLUTE(header_DATA_END - header_DATA_START);
    }
    __romPos += SIZEOF(.header);
    header_ROM_END = __romPos;
    header_VRAM_END = .;
    boot_ROM_START = __romPos;
    boot_VRAM = ADDR(.boot);
    .boot : AT(boot_ROM_START) SUBALIGN(16)
    {
        boot_DATA_START = .;
        boot_bin = .;
        build/assets/boot.bin.o(.data);
        boot_DATA_END = .;
        boot_DATA_SIZE = ABSOLUTE(boot_DATA_END - boot_DATA_START);
    }
    __romPos += SIZEOF(.boot);
    boot_ROM_END = __romPos;
    boot_VRAM_END = .;
    main_ROM_START = __romPos;
    main_VRAM = ADDR(.main);
    .main 0x80000400 : AT(main_ROM_START) SUBALIGN(16)
    {
        main_TEXT_START = .;
        build/asm/1000.o(.text);
        build/asm/11C0.o(.text);
        build/asm/1FC0.o(.text);
        build/asm/2360.o(.text);
        build/asm/2D80.o(.text);
        build/asm/5850.o(.text);
        build/asm/6BE0.o(.text);
        build/asm/6C90.o(.text);
        build/asm/6EA0.o(.text);
        build/asm/9D50.o(.text);
        build/asm/A160.o(.text);
        build/asm/A220.o(.text);
        build/asm/A910.o(.text);
        build/asm/DA40.o(.text);
        build/asm/E270.o(.text);
        build/asm/EBD0.o(.text);
        build/asm/EC90.o(.text);
        build/asm/10520.o(.text);
        build/asm/10640.o(.text);
        build/asm/108F0.o(.text);
        build/asm/10D60.o(.text);
        build/asm/12760.o(.text);
        build/asm/14060.o(.text);
        build/asm/14720.o(.text);
        build/asm/15020.o(.text);
        build/asm/15D60.o(.text);
        build/asm/16840.o(.text);
        build/asm/16BD0.o(.text);
        build/asm/198F0.o(.text);
        build/asm/19A90.o(.text);
        build/asm/19AA0.o(.text);
        build/src/code_1A230.o(.text);
        build/asm/1CA50.o(.text);
        build/asm/1CC30.o(.text);
        build/asm/1EDC0.o(.text);
        build/asm/1F0E0.o(.text);
        build/asm/1FD50.o(.text);
        build/asm/202A0.o(.text);
        main_TEXT_END = .;
        main_TEXT_SIZE = ABSOLUTE(main_TEXT_END - main_TEXT_START);
        main_DATA_START = .;
        _1000_s = .;
        build/asm/1000.o(.data);
        _11C0_s = .;
        build/asm/11C0.o(.data);
        _1FC0_s = .;
        build/asm/1FC0.o(.data);
        _2360_s = .;
        build/asm/2360.o(.data);
        _2D80_s = .;
        build/asm/2D80.o(.data);
        _5850_s = .;
        build/asm/5850.o(.data);
        _6BE0_s = .;
        build/asm/6BE0.o(.data);
        _6C90_s = .;
        build/asm/6C90.o(.data);
        _6EA0_s = .;
        build/asm/6EA0.o(.data);
        _9D50_s = .;
        build/asm/9D50.o(.data);
        A160_s = .;
        build/asm/A160.o(.data);
        A220_s = .;
        build/asm/A220.o(.data);
        A910_s = .;
        build/asm/A910.o(.data);
        DA40_s = .;
        build/asm/DA40.o(.data);
        E270_s = .;
        build/asm/E270.o(.data);
        EBD0_s = .;
        build/asm/EBD0.o(.data);
        EC90_s = .;
        build/asm/EC90.o(.data);
        _10520_s = .;
        build/asm/10520.o(.data);
        _10640_s = .;
        build/asm/10640.o(.data);
        _108F0_s = .;
        build/asm/108F0.o(.data);
        _10D60_s = .;
        build/asm/10D60.o(.data);
        _12760_s = .;
        build/asm/12760.o(.data);
        _14060_s = .;
        build/asm/14060.o(.data);
        _14720_s = .;
        build/asm/14720.o(.data);
        _15020_s = .;
        build/asm/15020.o(.data);
        _15D60_s = .;
        build/asm/15D60.o(.data);
        _16840_s = .;
        build/asm/16840.o(.data);
        _16BD0_s = .;
        build/asm/16BD0.o(.data);
        _198F0_s = .;
        build/asm/198F0.o(.data);
        _19A90_s = .;
        build/asm/19A90.o(.data);
        _19AA0_s = .;
        build/asm/19AA0.o(.data);
        code_1A230_c = .;
        build/src/code_1A230.o(.data);
        _1CA50_s = .;
        build/asm/1CA50.o(.data);
        _1CC30_s = .;
        build/asm/1CC30.o(.data);
        _1EDC0_s = .;
        build/asm/1EDC0.o(.data);
        _1F0E0_s = .;
        build/asm/1F0E0.o(.data);
        _1FD50_s = .;
        build/asm/1FD50.o(.data);
        _202A0_s = .;
        build/asm/202A0.o(.data);
        main_DATA_END = .;
        main_DATA_SIZE = ABSOLUTE(main_DATA_END - main_DATA_START);
        main_RODATA_START = .;
        build/asm/1000.o(.rodata);
        build/asm/11C0.o(.rodata);
        build/asm/1FC0.o(.rodata);
        build/asm/2360.o(.rodata);
        build/asm/2D80.o(.rodata);
        build/asm/5850.o(.rodata);
        build/asm/6BE0.o(.rodata);
        build/asm/6C90.o(.rodata);
        build/asm/6EA0.o(.rodata);
        build/asm/9D50.o(.rodata);
        build/asm/A160.o(.rodata);
        build/asm/A220.o(.rodata);
        build/asm/A910.o(.rodata);
        build/asm/DA40.o(.rodata);
        build/asm/E270.o(.rodata);
        build/asm/EBD0.o(.rodata);
        build/asm/EC90.o(.rodata);
        build/asm/10520.o(.rodata);
        build/asm/10640.o(.rodata);
        build/asm/108F0.o(.rodata);
        build/asm/10D60.o(.rodata);
        build/asm/12760.o(.rodata);
        build/asm/14060.o(.rodata);
        build/asm/14720.o(.rodata);
        build/asm/15020.o(.rodata);
        build/asm/15D60.o(.rodata);
        build/asm/16840.o(.rodata);
        build/asm/16BD0.o(.rodata);
        build/asm/198F0.o(.rodata);
        build/asm/19A90.o(.rodata);
        build/asm/19AA0.o(.rodata);
        build/src/code_1A230.o(.rodata);
        build/asm/1CA50.o(.rodata);
        build/asm/1CC30.o(.rodata);
        build/asm/1EDC0.o(.rodata);
        build/asm/1F0E0.o(.rodata);
        build/asm/1FD50.o(.rodata);
        build/asm/202A0.o(.rodata);
        main_RODATA_END = .;
        main_RODATA_SIZE = ABSOLUTE(main_RODATA_END - main_RODATA_START);
    }
    main_bss_VRAM = ADDR(.main_bss);
    .main_bss (NOLOAD) : SUBALIGN(16)
    {
        main_BSS_START = .;
        build/asm/1000.o(.bss);
        build/asm/11C0.o(.bss);
        build/asm/1FC0.o(.bss);
        build/asm/2360.o(.bss);
        build/asm/2D80.o(.bss);
        build/asm/5850.o(.bss);
        build/asm/6BE0.o(.bss);
        build/asm/6C90.o(.bss);
        build/asm/6EA0.o(.bss);
        build/asm/9D50.o(.bss);
        build/asm/A160.o(.bss);
        build/asm/A220.o(.bss);
        build/asm/A910.o(.bss);
        build/asm/DA40.o(.bss);
        build/asm/E270.o(.bss);
        build/asm/EBD0.o(.bss);
        build/asm/EC90.o(.bss);
        build/asm/10520.o(.bss);
        build/asm/10640.o(.bss);
        build/asm/108F0.o(.bss);
        build/asm/10D60.o(.bss);
        build/asm/12760.o(.bss);
        build/asm/14060.o(.bss);
        build/asm/14720.o(.bss);
        build/asm/15020.o(.bss);
        build/asm/15D60.o(.bss);
        build/asm/16840.o(.bss);
        build/asm/16BD0.o(.bss);
        build/asm/198F0.o(.bss);
        build/asm/19A90.o(.bss);
        build/asm/19AA0.o(.bss);
        build/src/code_1A230.o(.bss);
        build/asm/1CA50.o(.bss);
        build/asm/1CC30.o(.bss);
        build/asm/1EDC0.o(.bss);
        build/asm/1F0E0.o(.bss);
        build/asm/1FD50.o(.bss);
        build/asm/202A0.o(.bss);
        main_BSS_END = .;
        main_BSS_SIZE = ABSOLUTE(main_BSS_END - main_BSS_START);
    }
    __romPos += SIZEOF(.main);
    __romPos = ALIGN(__romPos, 16);
    main_ROM_END = __romPos;
    main_VRAM_END = .;
    _7CC30_ROM_START = __romPos;
    _7CC30_VRAM = ADDR(._7CC30);
    ._7CC30 : AT(_7CC30_ROM_START) SUBALIGN(16)
    {
        _7CC30_DATA_START = .;
        _7CC30_bin = .;
        build/assets/7CC30.bin.o(.data);
        _7CC30_DATA_END = .;
        _7CC30_DATA_SIZE = ABSOLUTE(_7CC30_DATA_END - _7CC30_DATA_START);
    }
    __romPos += SIZEOF(._7CC30);
    _7CC30_ROM_END = __romPos;
    _7CC30_VRAM_END = .;
    /DISCARD/ :
    {
        *(*);
    }
}

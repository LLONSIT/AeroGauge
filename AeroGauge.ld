SECTIONS
{
    __romPos = 0;
    _gp = 0x0;
    header_ROM_START = __romPos;
    header_VRAM = ADDR(.header);
    .header : AT(header_ROM_START) SUBALIGN(16)
    {
        header_DATA_START = .;
        header_s = .;
        build/asm/header.s.o(.data);
        header_DATA_END = .;
        header_DATA_SIZE = ABSOLUTE(header_DATA_END - header_DATA_START);
    }
    __romPos += SIZEOF(.header);
    header_ROM_END = __romPos;
    header_VRAM_END = .;

    boot_ROM_START = __romPos;
    boot_VRAM = ADDR(.boot);
    .boot : AT(boot_ROM_START) SUBALIGN(16)
    {
        boot_DATA_START = .;
        boot_bin = .;
        build/assets/boot.bin.o(.data);
        boot_DATA_END = .;
        boot_DATA_SIZE = ABSOLUTE(boot_DATA_END - boot_DATA_START);
    }
    __romPos += SIZEOF(.boot);
    boot_ROM_END = __romPos;
    boot_VRAM_END = .;

    main_ROM_START = __romPos;
    main_VRAM = ADDR(.main);
    .main 0x80000400 : AT(main_ROM_START) SUBALIGN(16)
    {
        main_TEXT_START = .;
        build/asm/entrypoint.s.o(.text);
        build/asm/11C0.s.o(.text);
        build/asm/1FC0.s.o(.text);
        build/asm/2360.s.o(.text);
        build/asm/2D80.s.o(.text);
        build/asm/5850.s.o(.text);
        build/asm/6BE0.s.o(.text);
        build/src/game_6C90.c.o(.text);
        build/asm/6EA0.s.o(.text);
        build/asm/9D50.s.o(.text);
        build/src/game_A160.c.o(.text);
        build/asm/A220.s.o(.text);
        build/asm/A910.s.o(.text);
        build/src/game_DA40.c.o(.text);
        build/asm/E270.s.o(.text);
        build/asm/EBD0.s.o(.text);
        build/asm/EC90.s.o(.text);
        build/asm/10520.s.o(.text);
        build/asm/10640.s.o(.text);
        build/asm/108F0.s.o(.text);
        build/src/game_10D60.c.o(.text);
        build/asm/12760.s.o(.text);
        build/src/game_14060.c.o(.text);
        build/src/game_14720.c.o(.text);
        build/asm/15020.s.o(.text);
        build/src/game_15D60.c.o(.text);
        build/asm/16840.s.o(.text);
        build/src/game_16BD0.c.o(.text);
        build/asm/198F0.s.o(.text);
        build/asm/19A90.s.o(.text);
        build/asm/19AA0.s.o(.text);
        build/src/game_1A230.c.o(.text);
        build/src/game_1CA50.c.o(.text);
        build/src/game_1CC30.c.o(.text);
        build/src/game_1EDC0.c.o(.text);
        build/asm/1F0E0.s.o(.text);
        build/asm/1FD50.s.o(.text);
        build/src/game_202A0.c.o(.text);
        build/asm/20D90.s.o(.text);
        build/asm/22680.s.o(.text);
        build/asm/22EC0.s.o(.text);
        build/asm/24530.s.o(.text);
        build/src/game_24890.c.o(.text);
        build/asm/24B70.s.o(.text);
        build/asm/24CC0.s.o(.text);
        build/asm/24D00.s.o(.text);
        build/src/game_24DF0.c.o(.text);
        build/src/game_24E40.c.o(.text);
        build/asm/24EE0.s.o(.text);
        build/asm/25440.s.o(.text);
        build/asm/255D0.s.o(.text);
        build/asm/25760.s.o(.text);
        build/asm/25A60.s.o(.text);
        build/asm/25BE0.s.o(.text);
        build/asm/25D70.s.o(.text);
        build/src/game_25F20.c.o(.text);
        build/asm/25FC0.s.o(.text);
        build/src/game_26440.c.o(.text);
        build/asm/26520.s.o(.text);
        build/asm/265C0.s.o(.text);
        build/asm/26610.s.o(.text);
        build/asm/28470.s.o(.text);
        build/asm/2E0B0.s.o(.text);
        build/asm/2F1E0.s.o(.text);
        build/asm/337B0.s.o(.text);
        build/asm/37B40.s.o(.text);
        build/asm/3AD90.s.o(.text);
        build/asm/3C840.s.o(.text);
        build/src/game_3F900.c.o(.text);
        build/asm/43090.s.o(.text);
        build/asm/470E0.s.o(.text);
        build/asm/4B490.s.o(.text);
        build/asm/4FA50.s.o(.text);
        build/asm/53A60.s.o(.text);
        build/asm/57E00.s.o(.text);
        build/src/game_58530.c.o(.text);
        build/asm/58710.s.o(.text);
        build/asm/5D0C0.s.o(.text);
        build/src/game_5D350.c.o(.text);
        build/asm/5F6B0.s.o(.text);
        build/asm/61570.s.o(.text);
        build/src/game_62900.c.o(.text);
        build/asm/63A60.s.o(.text);
        build/asm/65610.s.o(.text);
        build/asm/65FF0.s.o(.text);
        build/asm/66230.s.o(.text);
        build/asm/66340.s.o(.text);
        build/asm/heapinit.s.o(.text);
        build/asm/heapalloc.s.o(.text);
        build/asm/bnkf.s.o(.text);
        build/asm/seqpsetbank.s.o(.text);
        build/asm/osCreateMesgQueue.s.o(.text);
        build/asm/invaldcache.s.o(.text);
        build/asm/pidma.s.o(.text);
        build/asm/seqpsetvol.s.o(.text);
        build/asm/seqpstop.s.o(.text);
        build/asm/recvmesg.s.o(.text);
        build/asm/cseq.s.o(.text);
        build/asm/alSeqpSetSeq.s.o(.text);
        build/asm/seqpplay.s.o(.text);
        build/asm/cents2ratio.s.o(.text);
        build/asm/sinf.s.o(.text);
        build/asm/sndpallocate.s.o(.text);
        build/asm/sndpsetsound.s.o(.text);
        build/asm/sndpsetvol.s.o(.text);
        build/src/os/audio/alSndpSetPan.c.o(.text);
        build/src/os/audio/alSndpSetFXMix.c.o(.text);
        build/src/os/audio/alSndpSetPitch.c.o(.text);
        build/src/os/audio/alSndpStop.c.o(.text);
        build/asm/sndpgetstate.s.o(.text);
        build/asm/aisetfreq.s.o(.text);
        build/asm/sl.s.o(.text);
        build/src/os/osCreateThread.c.o(.text);
        build/src/os/osStartThread.c.o(.text);
        build/asm/seqpdelete.s.o(.text);
        build/src/os/audio/alSndpDelete.c.o(.text);
        build/src/os/osVirtualToPhysical.c.o(.text);
        build/asm/aisetnextbuf.s.o(.text);
        build/asm/os/osAiGetLenght.s.o(.text);
        build/asm/synthesizer.s.o(.text);
        build/asm/sendmesg.s.o(.text);
        build/asm/seqplayer.s.o(.text);
        build/asm/event.s.o(.text);
        build/asm/synfreevoice.s.o(.text);
        build/asm/synsetvol.s.o(.text);
        build/asm/alSynSetPitch.s.o(.text);
        build/asm/alSynallocVoice.s.o(.text);
        build/asm/alSynStartVoiceParam.s.o(.text);
        build/asm/alSynSetFXMix.s.o(.text);
        build/asm/osSetintMask.s.o(.text);
        build/asm/scale.s.o(.text);
        build/asm/coss.s.o(.text);
        build/asm/cosf.s.o(.text);
        build/asm/sqrtf.s.o(.text);
        build/asm/seteventmesg.s.o(.text);
        build/asm/contsetch.s.o(.text);
        build/asm/controller.s.o(.text);
        build/asm/contreaddata.s.o(.text);
        build/asm/pfsinitpak.s.o(.text);
        build/asm/sins.s.o(.text);
        build/asm/translate.s.o(.text);
        build/asm/rotate.s.o(.text);
        build/asm/sprintf.s.o(.text);
        build/asm/perspective.s.o(.text);
        build/asm/lookat.s.o(.text);
        build/asm/mtxcatf.s.o(.text);
        build/asm/mtxutil.s.o(.text);
        build/asm/bzero.s.o(.text);
        build/asm/ll.s.o(.text);
        build/asm/gettime.s.o(.text);
        build/asm/llcvt.s.o(.text);
        build/asm/visetspecial.s.o(.text);
        build/asm/viblack.s.o(.text);
        build/asm/writebackdcacheall.s.o(.text);
        build/src/os/libc/osSyncPrintf.c.o(.text);
        build/src/os/libc/String.c.o(.text);
        build/asm/pfssearchfile.s.o(.text);
        build/asm/osPfsNumFiles.s.o(.text);
        build/asm/pfsfreeblocks.s.o(.text);
        build/asm/normalize.s.o(.text);
        build/asm/pfsfilestate.s.o(.text);
        build/asm/pfsrepairid.s.o(.text);
        build/asm/pfsdeletefile.s.o(.text);
        build/asm/conteepprobe.s.o(.text);
        build/asm/conteepread.s.o(.text);
        build/asm/conteeplongwrite.s.o(.text);
        build/asm/conteeplongread.s.o(.text);
        build/asm/motor.s.o(.text);
        build/asm/pfsreadwritefile.s.o(.text);
        build/asm/pfsallocatefile.s.o(.text);
        build/asm/703F0.s.o(.text);
        build/asm/visetmode.s.o(.text);
        build/asm/osViSetEvent.s.o(.text);
        build/asm/sptaskyielded.s.o(.text);
        build/asm/708B0.s.o(.text);
        build/asm/jammesg.s.o(.text);
        build/asm/viswapbuf.s.o(.text);
        build/asm/sptask.s.o(.text);
        build/asm/dpsetnextbuf.s.o(.text);
        build/asm/sptaskyield.s.o(.text);
        build/asm/initialize.s.o(.text);
        build/asm/setthreadpri.s.o(.text);
        build/asm/pimgr.s.o(.text);
        build/asm/71390.s.o(.text);
        build/asm/thread.s.o(.text);
        build/asm/pigetcmdq.s.o(.text);
        build/asm/interrupt.s.o(.text);
        build/asm/exceptasm.s.o(.text);
        build/asm/syndelete.s.o(.text);
        build/asm/synremoveplayer.s.o(.text);
        build/asm/probetlb.s.o(.text);
        build/asm/ai.s.o(.text);
        build/asm/drvrNew.s.o(.text);
        build/asm/synallocfx.s.o(.text);
        build/asm/mainbus.s.o(.text);
        build/asm/load.s.o(.text);
        build/asm/resample.s.o(.text);
        build/asm/env.s.o(.text);
        build/asm/auxbus.s.o(.text);
        build/asm/save.s.o(.text);
        build/asm/seq.s.o(.text);
        build/asm/synsetpriority.s.o(.text);
        build/asm/copy.s.o(.text);
        build/asm/74CA0.s.o(.text);
        build/asm/settimer.s.o(.text);
        build/asm/sirawdma.s.o(.text);
        build/asm/pfsgetstatus.s.o(.text);
        build/asm/contpfs.s.o(.text);
        build/asm/contramread.s.o(.text);
        build/asm/pfschecker.s.o(.text);
        build/asm/osGetCount.s.o(.text);
        build/asm/timerintr.s.o(.text);
        build/asm/contramwrite.s.o(.text);
        build/asm/conteepwrite.s.o(.text);
        build/asm/pfsisplug.s.o(.text);
        build/asm/crc.s.o(.text);
        build/asm/getthreadpri.s.o(.text);
        build/asm/getactivequeue.s.o(.text);
        build/asm/78BD0.s.o(.text);
        build/asm/spgetstat.s.o(.text);
        build/asm/bcopy.s.o(.text);
        build/asm/writebackdcache.s.o(.text);
        build/asm/spsetstat.s.o(.text);
        build/asm/spsetpc.s.o(.text);
        build/asm/sprawdma.s.o(.text);
        build/asm/sp.s.o(.text);
        build/asm/osDpDeviceBusy.s.o(.text);
        build/asm/setsr.s.o(.text);
        build/asm/getsr.s.o(.text);
        build/asm/setfpccsr.s.o(.text);
        build/asm/sprawread.s.o(.text);
        build/asm/sprawwrite.s.o(.text);
        build/asm/invalicache.s.o(.text);
        build/asm/maptlbrdb.s.o(.text);
        build/asm/pirawread.s.o(.text);
        build/asm/cartrominit.s.o(.text);
        build/asm/leodiskinit.s.o(.text);
        build/asm/79840.s.o(.text);
        build/asm/pirawdma.s.o(.text);
        build/asm/epirawdma.s.o(.text);
        build/asm/devmgr.s.o(.text);
        build/asm/leointerrupt.s.o(.text);
        build/asm/destroythread.s.o(.text);
        build/asm/filter.s.o(.text);
        build/asm/reverb.s.o(.text);
        build/asm/si.s.o(.text);
        build/asm/xlitob.s.o(.text);
        build/asm/xldtob.s.o(.text);
        build/asm/setcompare.s.o(.text);
        build/asm/resetglobalintmask.s.o(.text);
        build/asm/epirawwrite.s.o(.text);
        build/asm/epirawread.s.o(.text);
        build/asm/setglobalintmask.s.o(.text);
        build/asm/yieldthread.s.o(.text);
        build/asm/ldiv.s.o(.text);
        main_TEXT_END = .;
        main_TEXT_SIZE = ABSOLUTE(main_TEXT_END - main_TEXT_START);
        main_RODATA_START = .;
        build/asm/data/7CA00.rodata.s.o(.rodata);
        build/asm/data/7CAD0.rodata.s.o(.rodata);
        main_RODATA_END = .;
        main_RODATA_SIZE = ABSOLUTE(main_RODATA_END - main_RODATA_START);
        main_DATA_START = .;
        entrypoint_s = .;
        build/asm/entrypoint.s.o(.data);
        _11C0_s = .;
        build/asm/11C0.s.o(.data);
        _1FC0_s = .;
        build/asm/1FC0.s.o(.data);
        _2360_s = .;
        build/asm/2360.s.o(.data);
        _2D80_s = .;
        build/asm/2D80.s.o(.data);
        _5850_s = .;
        build/asm/5850.s.o(.data);
        _6BE0_s = .;
        build/asm/6BE0.s.o(.data);
        game_6C90_c = .;
        build/src/game_6C90.c.o(.data);
        _6EA0_s = .;
        build/asm/6EA0.s.o(.data);
        _9D50_s = .;
        build/asm/9D50.s.o(.data);
        game_A160_c = .;
        build/src/game_A160.c.o(.data);
        A220_s = .;
        build/asm/A220.s.o(.data);
        A910_s = .;
        build/asm/A910.s.o(.data);
        game_DA40_c = .;
        build/src/game_DA40.c.o(.data);
        E270_s = .;
        build/asm/E270.s.o(.data);
        EBD0_s = .;
        build/asm/EBD0.s.o(.data);
        EC90_s = .;
        build/asm/EC90.s.o(.data);
        _10520_s = .;
        build/asm/10520.s.o(.data);
        _10640_s = .;
        build/asm/10640.s.o(.data);
        _108F0_s = .;
        build/asm/108F0.s.o(.data);
        game_10D60_c = .;
        build/src/game_10D60.c.o(.data);
        _12760_s = .;
        build/asm/12760.s.o(.data);
        game_14060_c = .;
        build/src/game_14060.c.o(.data);
        game_14720_c = .;
        build/src/game_14720.c.o(.data);
        _15020_s = .;
        build/asm/15020.s.o(.data);
        game_15D60_c = .;
        build/src/game_15D60.c.o(.data);
        _16840_s = .;
        build/asm/16840.s.o(.data);
        game_16BD0_c = .;
        build/src/game_16BD0.c.o(.data);
        _198F0_s = .;
        build/asm/198F0.s.o(.data);
        _19A90_s = .;
        build/asm/19A90.s.o(.data);
        _19AA0_s = .;
        build/asm/19AA0.s.o(.data);
        game_1A230_c = .;
        build/src/game_1A230.c.o(.data);
        game_1CA50_c = .;
        build/src/game_1CA50.c.o(.data);
        game_1CC30_c = .;
        build/src/game_1CC30.c.o(.data);
        game_1EDC0_c = .;
        build/src/game_1EDC0.c.o(.data);
        _1F0E0_s = .;
        build/asm/1F0E0.s.o(.data);
        _1FD50_s = .;
        build/asm/1FD50.s.o(.data);
        game_202A0_c = .;
        build/src/game_202A0.c.o(.data);
        _20D90_s = .;
        build/asm/20D90.s.o(.data);
        _22680_s = .;
        build/asm/22680.s.o(.data);
        _22EC0_s = .;
        build/asm/22EC0.s.o(.data);
        _24530_s = .;
        build/asm/24530.s.o(.data);
        game_24890_c = .;
        build/src/game_24890.c.o(.data);
        _24B70_s = .;
        build/asm/24B70.s.o(.data);
        _24CC0_s = .;
        build/asm/24CC0.s.o(.data);
        _24D00_s = .;
        build/asm/24D00.s.o(.data);
        game_24DF0_c = .;
        build/src/game_24DF0.c.o(.data);
        game_24E40_c = .;
        build/src/game_24E40.c.o(.data);
        _24EE0_s = .;
        build/asm/24EE0.s.o(.data);
        _25440_s = .;
        build/asm/25440.s.o(.data);
        _255D0_s = .;
        build/asm/255D0.s.o(.data);
        _25760_s = .;
        build/asm/25760.s.o(.data);
        _25A60_s = .;
        build/asm/25A60.s.o(.data);
        _25BE0_s = .;
        build/asm/25BE0.s.o(.data);
        _25D70_s = .;
        build/asm/25D70.s.o(.data);
        game_25F20_c = .;
        build/src/game_25F20.c.o(.data);
        _25FC0_s = .;
        build/asm/25FC0.s.o(.data);
        game_26440_c = .;
        build/src/game_26440.c.o(.data);
        _26520_s = .;
        build/asm/26520.s.o(.data);
        _265C0_s = .;
        build/asm/265C0.s.o(.data);
        _26610_s = .;
        build/asm/26610.s.o(.data);
        _28470_s = .;
        build/asm/28470.s.o(.data);
        _2E0B0_s = .;
        build/asm/2E0B0.s.o(.data);
        _2F1E0_s = .;
        build/asm/2F1E0.s.o(.data);
        _337B0_s = .;
        build/asm/337B0.s.o(.data);
        _37B40_s = .;
        build/asm/37B40.s.o(.data);
        _3AD90_s = .;
        build/asm/3AD90.s.o(.data);
        _3C840_s = .;
        build/asm/3C840.s.o(.data);
        game_3F900_c = .;
        build/src/game_3F900.c.o(.data);
        _43090_s = .;
        build/asm/43090.s.o(.data);
        _470E0_s = .;
        build/asm/470E0.s.o(.data);
        _4B490_s = .;
        build/asm/4B490.s.o(.data);
        _4FA50_s = .;
        build/asm/4FA50.s.o(.data);
        _53A60_s = .;
        build/asm/53A60.s.o(.data);
        _57E00_s = .;
        build/asm/57E00.s.o(.data);
        game_58530_c = .;
        build/src/game_58530.c.o(.data);
        _58710_s = .;
        build/asm/58710.s.o(.data);
        _5D0C0_s = .;
        build/asm/5D0C0.s.o(.data);
        game_5D350_c = .;
        build/src/game_5D350.c.o(.data);
        _5F6B0_s = .;
        build/asm/5F6B0.s.o(.data);
        _61570_s = .;
        build/asm/61570.s.o(.data);
        game_62900_c = .;
        build/src/game_62900.c.o(.data);
        _63A60_s = .;
        build/asm/63A60.s.o(.data);
        _65610_s = .;
        build/asm/65610.s.o(.data);
        _65FF0_s = .;
        build/asm/65FF0.s.o(.data);
        _66230_s = .;
        build/asm/66230.s.o(.data);
        _66340_s = .;
        build/asm/66340.s.o(.data);
        heapinit_s = .;
        build/asm/heapinit.s.o(.data);
        heapalloc_s = .;
        build/asm/heapalloc.s.o(.data);
        bnkf_s = .;
        build/asm/bnkf.s.o(.data);
        seqpsetbank_s = .;
        build/asm/seqpsetbank.s.o(.data);
        osCreateMesgQueue_s = .;
        build/asm/osCreateMesgQueue.s.o(.data);
        invaldcache_s = .;
        build/asm/invaldcache.s.o(.data);
        pidma_s = .;
        build/asm/pidma.s.o(.data);
        seqpsetvol_s = .;
        build/asm/seqpsetvol.s.o(.data);
        seqpstop_s = .;
        build/asm/seqpstop.s.o(.data);
        recvmesg_s = .;
        build/asm/recvmesg.s.o(.data);
        cseq_s = .;
        build/asm/cseq.s.o(.data);
        alSeqpSetSeq_s = .;
        build/asm/alSeqpSetSeq.s.o(.data);
        seqpplay_s = .;
        build/asm/seqpplay.s.o(.data);
        cents2ratio_s = .;
        build/asm/cents2ratio.s.o(.data);
        sinf_s = .;
        build/asm/sinf.s.o(.data);
        sndpallocate_s = .;
        build/asm/sndpallocate.s.o(.data);
        sndpsetsound_s = .;
        build/asm/sndpsetsound.s.o(.data);
        sndpsetvol_s = .;
        build/asm/sndpsetvol.s.o(.data);
        os_audio_alSndpSetPan_c = .;
        build/src/os/audio/alSndpSetPan.c.o(.data);
        os_audio_alSndpSetFXMix_c = .;
        build/src/os/audio/alSndpSetFXMix.c.o(.data);
        os_audio_alSndpSetPitch_c = .;
        build/src/os/audio/alSndpSetPitch.c.o(.data);
        os_audio_alSndpStop_c = .;
        build/src/os/audio/alSndpStop.c.o(.data);
        sndpgetstate_s = .;
        build/asm/sndpgetstate.s.o(.data);
        aisetfreq_s = .;
        build/asm/aisetfreq.s.o(.data);
        sl_s = .;
        build/asm/sl.s.o(.data);
        os_osCreateThread_c = .;
        build/src/os/osCreateThread.c.o(.data);
        os_osStartThread_c = .;
        build/src/os/osStartThread.c.o(.data);
        seqpdelete_s = .;
        build/asm/seqpdelete.s.o(.data);
        os_audio_alSndpDelete_c = .;
        build/src/os/audio/alSndpDelete.c.o(.data);
        os_osVirtualToPhysical_c = .;
        build/src/os/osVirtualToPhysical.c.o(.data);
        aisetnextbuf_s = .;
        build/asm/aisetnextbuf.s.o(.data);
        os_osAiGetLenght_s = .;
        build/asm/os/osAiGetLenght.s.o(.data);
        synthesizer_s = .;
        build/asm/synthesizer.s.o(.data);
        sendmesg_s = .;
        build/asm/sendmesg.s.o(.data);
        seqplayer_s = .;
        build/asm/seqplayer.s.o(.data);
        event_s = .;
        build/asm/event.s.o(.data);
        synfreevoice_s = .;
        build/asm/synfreevoice.s.o(.data);
        synsetvol_s = .;
        build/asm/synsetvol.s.o(.data);
        alSynSetPitch_s = .;
        build/asm/alSynSetPitch.s.o(.data);
        alSynallocVoice_s = .;
        build/asm/alSynallocVoice.s.o(.data);
        alSynStartVoiceParam_s = .;
        build/asm/alSynStartVoiceParam.s.o(.data);
        alSynSetFXMix_s = .;
        build/asm/alSynSetFXMix.s.o(.data);
        osSetintMask_s = .;
        build/asm/osSetintMask.s.o(.data);
        scale_s = .;
        build/asm/scale.s.o(.data);
        coss_s = .;
        build/asm/coss.s.o(.data);
        cosf_s = .;
        build/asm/cosf.s.o(.data);
        sqrtf_s = .;
        build/asm/sqrtf.s.o(.data);
        seteventmesg_s = .;
        build/asm/seteventmesg.s.o(.data);
        contsetch_s = .;
        build/asm/contsetch.s.o(.data);
        controller_s = .;
        build/asm/controller.s.o(.data);
        contreaddata_s = .;
        build/asm/contreaddata.s.o(.data);
        pfsinitpak_s = .;
        build/asm/pfsinitpak.s.o(.data);
        sins_s = .;
        build/asm/sins.s.o(.data);
        translate_s = .;
        build/asm/translate.s.o(.data);
        rotate_s = .;
        build/asm/rotate.s.o(.data);
        sprintf_s = .;
        build/asm/sprintf.s.o(.data);
        perspective_s = .;
        build/asm/perspective.s.o(.data);
        lookat_s = .;
        build/asm/lookat.s.o(.data);
        mtxcatf_s = .;
        build/asm/mtxcatf.s.o(.data);
        mtxutil_s = .;
        build/asm/mtxutil.s.o(.data);
        bzero_s = .;
        build/asm/bzero.s.o(.data);
        ll_s = .;
        build/asm/ll.s.o(.data);
        gettime_s = .;
        build/asm/gettime.s.o(.data);
        llcvt_s = .;
        build/asm/llcvt.s.o(.data);
        visetspecial_s = .;
        build/asm/visetspecial.s.o(.data);
        viblack_s = .;
        build/asm/viblack.s.o(.data);
        writebackdcacheall_s = .;
        build/asm/writebackdcacheall.s.o(.data);
        os_libc_osSyncPrintf_c = .;
        build/src/os/libc/osSyncPrintf.c.o(.data);
        os_libc_String_c = .;
        build/src/os/libc/String.c.o(.data);
        pfssearchfile_s = .;
        build/asm/pfssearchfile.s.o(.data);
        osPfsNumFiles_s = .;
        build/asm/osPfsNumFiles.s.o(.data);
        pfsfreeblocks_s = .;
        build/asm/pfsfreeblocks.s.o(.data);
        normalize_s = .;
        build/asm/normalize.s.o(.data);
        pfsfilestate_s = .;
        build/asm/pfsfilestate.s.o(.data);
        pfsrepairid_s = .;
        build/asm/pfsrepairid.s.o(.data);
        pfsdeletefile_s = .;
        build/asm/pfsdeletefile.s.o(.data);
        conteepprobe_s = .;
        build/asm/conteepprobe.s.o(.data);
        conteepread_s = .;
        build/asm/conteepread.s.o(.data);
        conteeplongwrite_s = .;
        build/asm/conteeplongwrite.s.o(.data);
        conteeplongread_s = .;
        build/asm/conteeplongread.s.o(.data);
        motor_s = .;
        build/asm/motor.s.o(.data);
        pfsreadwritefile_s = .;
        build/asm/pfsreadwritefile.s.o(.data);
        pfsallocatefile_s = .;
        build/asm/pfsallocatefile.s.o(.data);
        _703F0_s = .;
        build/asm/703F0.s.o(.data);
        visetmode_s = .;
        build/asm/visetmode.s.o(.data);
        osViSetEvent_s = .;
        build/asm/osViSetEvent.s.o(.data);
        sptaskyielded_s = .;
        build/asm/sptaskyielded.s.o(.data);
        _708B0_s = .;
        build/asm/708B0.s.o(.data);
        jammesg_s = .;
        build/asm/jammesg.s.o(.data);
        viswapbuf_s = .;
        build/asm/viswapbuf.s.o(.data);
        sptask_s = .;
        build/asm/sptask.s.o(.data);
        dpsetnextbuf_s = .;
        build/asm/dpsetnextbuf.s.o(.data);
        sptaskyield_s = .;
        build/asm/sptaskyield.s.o(.data);
        initialize_s = .;
        build/asm/initialize.s.o(.data);
        setthreadpri_s = .;
        build/asm/setthreadpri.s.o(.data);
        pimgr_s = .;
        build/asm/pimgr.s.o(.data);
        _71390_s = .;
        build/asm/71390.s.o(.data);
        thread_s = .;
        build/asm/thread.s.o(.data);
        pigetcmdq_s = .;
        build/asm/pigetcmdq.s.o(.data);
        interrupt_s = .;
        build/asm/interrupt.s.o(.data);
        exceptasm_s = .;
        build/asm/exceptasm.s.o(.data);
        syndelete_s = .;
        build/asm/syndelete.s.o(.data);
        synremoveplayer_s = .;
        build/asm/synremoveplayer.s.o(.data);
        probetlb_s = .;
        build/asm/probetlb.s.o(.data);
        ai_s = .;
        build/asm/ai.s.o(.data);
        drvrNew_s = .;
        build/asm/drvrNew.s.o(.data);
        synallocfx_s = .;
        build/asm/synallocfx.s.o(.data);
        mainbus_s = .;
        build/asm/mainbus.s.o(.data);
        load_s = .;
        build/asm/load.s.o(.data);
        resample_s = .;
        build/asm/resample.s.o(.data);
        env_s = .;
        build/asm/env.s.o(.data);
        auxbus_s = .;
        build/asm/auxbus.s.o(.data);
        save_s = .;
        build/asm/save.s.o(.data);
        seq_s = .;
        build/asm/seq.s.o(.data);
        synsetpriority_s = .;
        build/asm/synsetpriority.s.o(.data);
        copy_s = .;
        build/asm/copy.s.o(.data);
        _74CA0_s = .;
        build/asm/74CA0.s.o(.data);
        settimer_s = .;
        build/asm/settimer.s.o(.data);
        sirawdma_s = .;
        build/asm/sirawdma.s.o(.data);
        pfsgetstatus_s = .;
        build/asm/pfsgetstatus.s.o(.data);
        contpfs_s = .;
        build/asm/contpfs.s.o(.data);
        contramread_s = .;
        build/asm/contramread.s.o(.data);
        pfschecker_s = .;
        build/asm/pfschecker.s.o(.data);
        osGetCount_s = .;
        build/asm/osGetCount.s.o(.data);
        timerintr_s = .;
        build/asm/timerintr.s.o(.data);
        contramwrite_s = .;
        build/asm/contramwrite.s.o(.data);
        conteepwrite_s = .;
        build/asm/conteepwrite.s.o(.data);
        pfsisplug_s = .;
        build/asm/pfsisplug.s.o(.data);
        crc_s = .;
        build/asm/crc.s.o(.data);
        getthreadpri_s = .;
        build/asm/getthreadpri.s.o(.data);
        getactivequeue_s = .;
        build/asm/getactivequeue.s.o(.data);
        _78BD0_s = .;
        build/asm/78BD0.s.o(.data);
        spgetstat_s = .;
        build/asm/spgetstat.s.o(.data);
        bcopy_s = .;
        build/asm/bcopy.s.o(.data);
        writebackdcache_s = .;
        build/asm/writebackdcache.s.o(.data);
        spsetstat_s = .;
        build/asm/spsetstat.s.o(.data);
        spsetpc_s = .;
        build/asm/spsetpc.s.o(.data);
        sprawdma_s = .;
        build/asm/sprawdma.s.o(.data);
        sp_s = .;
        build/asm/sp.s.o(.data);
        osDpDeviceBusy_s = .;
        build/asm/osDpDeviceBusy.s.o(.data);
        setsr_s = .;
        build/asm/setsr.s.o(.data);
        getsr_s = .;
        build/asm/getsr.s.o(.data);
        setfpccsr_s = .;
        build/asm/setfpccsr.s.o(.data);
        sprawread_s = .;
        build/asm/sprawread.s.o(.data);
        sprawwrite_s = .;
        build/asm/sprawwrite.s.o(.data);
        invalicache_s = .;
        build/asm/invalicache.s.o(.data);
        maptlbrdb_s = .;
        build/asm/maptlbrdb.s.o(.data);
        pirawread_s = .;
        build/asm/pirawread.s.o(.data);
        cartrominit_s = .;
        build/asm/cartrominit.s.o(.data);
        leodiskinit_s = .;
        build/asm/leodiskinit.s.o(.data);
        _79840_s = .;
        build/asm/79840.s.o(.data);
        pirawdma_s = .;
        build/asm/pirawdma.s.o(.data);
        epirawdma_s = .;
        build/asm/epirawdma.s.o(.data);
        devmgr_s = .;
        build/asm/devmgr.s.o(.data);
        leointerrupt_s = .;
        build/asm/leointerrupt.s.o(.data);
        destroythread_s = .;
        build/asm/destroythread.s.o(.data);
        filter_s = .;
        build/asm/filter.s.o(.data);
        reverb_s = .;
        build/asm/reverb.s.o(.data);
        si_s = .;
        build/asm/si.s.o(.data);
        xlitob_s = .;
        build/asm/xlitob.s.o(.data);
        xldtob_s = .;
        build/asm/xldtob.s.o(.data);
        setcompare_s = .;
        build/asm/setcompare.s.o(.data);
        resetglobalintmask_s = .;
        build/asm/resetglobalintmask.s.o(.data);
        epirawwrite_s = .;
        build/asm/epirawwrite.s.o(.data);
        epirawread_s = .;
        build/asm/epirawread.s.o(.data);
        setglobalintmask_s = .;
        build/asm/setglobalintmask.s.o(.data);
        yieldthread_s = .;
        build/asm/yieldthread.s.o(.data);
        ldiv_s = .;
        build/asm/ldiv.s.o(.data);
        main_DATA_END = .;
        main_DATA_SIZE = ABSOLUTE(main_DATA_END - main_DATA_START);
    }
    main_bss_VRAM = ADDR(.main_bss);
    .main_bss (NOLOAD) : SUBALIGN(16)
    {
        main_BSS_START = .;
        build/asm/entrypoint.s.o(.bss);
        build/asm/11C0.s.o(.bss);
        build/asm/1FC0.s.o(.bss);
        build/asm/2360.s.o(.bss);
        build/asm/2D80.s.o(.bss);
        build/asm/5850.s.o(.bss);
        build/asm/6BE0.s.o(.bss);
        build/src/game_6C90.c.o(.bss);
        build/asm/6EA0.s.o(.bss);
        build/asm/9D50.s.o(.bss);
        build/src/game_A160.c.o(.bss);
        build/asm/A220.s.o(.bss);
        build/asm/A910.s.o(.bss);
        build/src/game_DA40.c.o(.bss);
        build/asm/E270.s.o(.bss);
        build/asm/EBD0.s.o(.bss);
        build/asm/EC90.s.o(.bss);
        build/asm/10520.s.o(.bss);
        build/asm/10640.s.o(.bss);
        build/asm/108F0.s.o(.bss);
        build/src/game_10D60.c.o(.bss);
        build/asm/12760.s.o(.bss);
        build/src/game_14060.c.o(.bss);
        build/src/game_14720.c.o(.bss);
        build/asm/15020.s.o(.bss);
        build/src/game_15D60.c.o(.bss);
        build/asm/16840.s.o(.bss);
        build/src/game_16BD0.c.o(.bss);
        build/asm/198F0.s.o(.bss);
        build/asm/19A90.s.o(.bss);
        build/asm/19AA0.s.o(.bss);
        build/src/game_1A230.c.o(.bss);
        build/src/game_1CA50.c.o(.bss);
        build/src/game_1CC30.c.o(.bss);
        build/src/game_1EDC0.c.o(.bss);
        build/asm/1F0E0.s.o(.bss);
        build/asm/1FD50.s.o(.bss);
        build/src/game_202A0.c.o(.bss);
        build/asm/20D90.s.o(.bss);
        build/asm/22680.s.o(.bss);
        build/asm/22EC0.s.o(.bss);
        build/asm/24530.s.o(.bss);
        build/src/game_24890.c.o(.bss);
        build/asm/24B70.s.o(.bss);
        build/asm/24CC0.s.o(.bss);
        build/asm/24D00.s.o(.bss);
        build/src/game_24DF0.c.o(.bss);
        build/src/game_24E40.c.o(.bss);
        build/asm/24EE0.s.o(.bss);
        build/asm/25440.s.o(.bss);
        build/asm/255D0.s.o(.bss);
        build/asm/25760.s.o(.bss);
        build/asm/25A60.s.o(.bss);
        build/asm/25BE0.s.o(.bss);
        build/asm/25D70.s.o(.bss);
        build/src/game_25F20.c.o(.bss);
        build/asm/25FC0.s.o(.bss);
        build/src/game_26440.c.o(.bss);
        build/asm/26520.s.o(.bss);
        build/asm/265C0.s.o(.bss);
        build/asm/26610.s.o(.bss);
        build/asm/28470.s.o(.bss);
        build/asm/2E0B0.s.o(.bss);
        build/asm/2F1E0.s.o(.bss);
        build/asm/337B0.s.o(.bss);
        build/asm/37B40.s.o(.bss);
        build/asm/3AD90.s.o(.bss);
        build/asm/3C840.s.o(.bss);
        build/src/game_3F900.c.o(.bss);
        build/asm/43090.s.o(.bss);
        build/asm/470E0.s.o(.bss);
        build/asm/4B490.s.o(.bss);
        build/asm/4FA50.s.o(.bss);
        build/asm/53A60.s.o(.bss);
        build/asm/57E00.s.o(.bss);
        build/src/game_58530.c.o(.bss);
        build/asm/58710.s.o(.bss);
        build/asm/5D0C0.s.o(.bss);
        build/src/game_5D350.c.o(.bss);
        build/asm/5F6B0.s.o(.bss);
        build/asm/61570.s.o(.bss);
        build/src/game_62900.c.o(.bss);
        build/asm/63A60.s.o(.bss);
        build/asm/65610.s.o(.bss);
        build/asm/65FF0.s.o(.bss);
        build/asm/66230.s.o(.bss);
        build/asm/66340.s.o(.bss);
        build/asm/heapinit.s.o(.bss);
        build/asm/heapalloc.s.o(.bss);
        build/asm/bnkf.s.o(.bss);
        build/asm/seqpsetbank.s.o(.bss);
        build/asm/osCreateMesgQueue.s.o(.bss);
        build/asm/invaldcache.s.o(.bss);
        build/asm/pidma.s.o(.bss);
        build/asm/seqpsetvol.s.o(.bss);
        build/asm/seqpstop.s.o(.bss);
        build/asm/recvmesg.s.o(.bss);
        build/asm/cseq.s.o(.bss);
        build/asm/alSeqpSetSeq.s.o(.bss);
        build/asm/seqpplay.s.o(.bss);
        build/asm/cents2ratio.s.o(.bss);
        build/asm/sinf.s.o(.bss);
        build/asm/sndpallocate.s.o(.bss);
        build/asm/sndpsetsound.s.o(.bss);
        build/asm/sndpsetvol.s.o(.bss);
        build/src/os/audio/alSndpSetPan.c.o(.bss);
        build/src/os/audio/alSndpSetFXMix.c.o(.bss);
        build/src/os/audio/alSndpSetPitch.c.o(.bss);
        build/src/os/audio/alSndpStop.c.o(.bss);
        build/asm/sndpgetstate.s.o(.bss);
        build/asm/aisetfreq.s.o(.bss);
        build/asm/sl.s.o(.bss);
        build/src/os/osCreateThread.c.o(.bss);
        build/src/os/osStartThread.c.o(.bss);
        build/asm/seqpdelete.s.o(.bss);
        build/src/os/audio/alSndpDelete.c.o(.bss);
        build/src/os/osVirtualToPhysical.c.o(.bss);
        build/asm/aisetnextbuf.s.o(.bss);
        build/asm/os/osAiGetLenght.s.o(.bss);
        build/asm/synthesizer.s.o(.bss);
        build/asm/sendmesg.s.o(.bss);
        build/asm/seqplayer.s.o(.bss);
        build/asm/event.s.o(.bss);
        build/asm/synfreevoice.s.o(.bss);
        build/asm/synsetvol.s.o(.bss);
        build/asm/alSynSetPitch.s.o(.bss);
        build/asm/alSynallocVoice.s.o(.bss);
        build/asm/alSynStartVoiceParam.s.o(.bss);
        build/asm/alSynSetFXMix.s.o(.bss);
        build/asm/osSetintMask.s.o(.bss);
        build/asm/scale.s.o(.bss);
        build/asm/coss.s.o(.bss);
        build/asm/cosf.s.o(.bss);
        build/asm/sqrtf.s.o(.bss);
        build/asm/seteventmesg.s.o(.bss);
        build/asm/contsetch.s.o(.bss);
        build/asm/controller.s.o(.bss);
        build/asm/contreaddata.s.o(.bss);
        build/asm/pfsinitpak.s.o(.bss);
        build/asm/sins.s.o(.bss);
        build/asm/translate.s.o(.bss);
        build/asm/rotate.s.o(.bss);
        build/asm/sprintf.s.o(.bss);
        build/asm/perspective.s.o(.bss);
        build/asm/lookat.s.o(.bss);
        build/asm/mtxcatf.s.o(.bss);
        build/asm/mtxutil.s.o(.bss);
        build/asm/bzero.s.o(.bss);
        build/asm/ll.s.o(.bss);
        build/asm/gettime.s.o(.bss);
        build/asm/llcvt.s.o(.bss);
        build/asm/visetspecial.s.o(.bss);
        build/asm/viblack.s.o(.bss);
        build/asm/writebackdcacheall.s.o(.bss);
        build/src/os/libc/osSyncPrintf.c.o(.bss);
        build/src/os/libc/String.c.o(.bss);
        build/asm/pfssearchfile.s.o(.bss);
        build/asm/osPfsNumFiles.s.o(.bss);
        build/asm/pfsfreeblocks.s.o(.bss);
        build/asm/normalize.s.o(.bss);
        build/asm/pfsfilestate.s.o(.bss);
        build/asm/pfsrepairid.s.o(.bss);
        build/asm/pfsdeletefile.s.o(.bss);
        build/asm/conteepprobe.s.o(.bss);
        build/asm/conteepread.s.o(.bss);
        build/asm/conteeplongwrite.s.o(.bss);
        build/asm/conteeplongread.s.o(.bss);
        build/asm/motor.s.o(.bss);
        build/asm/pfsreadwritefile.s.o(.bss);
        build/asm/pfsallocatefile.s.o(.bss);
        build/asm/703F0.s.o(.bss);
        build/asm/visetmode.s.o(.bss);
        build/asm/osViSetEvent.s.o(.bss);
        build/asm/sptaskyielded.s.o(.bss);
        build/asm/708B0.s.o(.bss);
        build/asm/jammesg.s.o(.bss);
        build/asm/viswapbuf.s.o(.bss);
        build/asm/sptask.s.o(.bss);
        build/asm/dpsetnextbuf.s.o(.bss);
        build/asm/sptaskyield.s.o(.bss);
        build/asm/initialize.s.o(.bss);
        build/asm/setthreadpri.s.o(.bss);
        build/asm/pimgr.s.o(.bss);
        build/asm/71390.s.o(.bss);
        build/asm/thread.s.o(.bss);
        build/asm/pigetcmdq.s.o(.bss);
        build/asm/interrupt.s.o(.bss);
        build/asm/exceptasm.s.o(.bss);
        build/asm/syndelete.s.o(.bss);
        build/asm/synremoveplayer.s.o(.bss);
        build/asm/probetlb.s.o(.bss);
        build/asm/ai.s.o(.bss);
        build/asm/drvrNew.s.o(.bss);
        build/asm/synallocfx.s.o(.bss);
        build/asm/mainbus.s.o(.bss);
        build/asm/load.s.o(.bss);
        build/asm/resample.s.o(.bss);
        build/asm/env.s.o(.bss);
        build/asm/auxbus.s.o(.bss);
        build/asm/save.s.o(.bss);
        build/asm/seq.s.o(.bss);
        build/asm/synsetpriority.s.o(.bss);
        build/asm/copy.s.o(.bss);
        build/asm/74CA0.s.o(.bss);
        build/asm/settimer.s.o(.bss);
        build/asm/sirawdma.s.o(.bss);
        build/asm/pfsgetstatus.s.o(.bss);
        build/asm/contpfs.s.o(.bss);
        build/asm/contramread.s.o(.bss);
        build/asm/pfschecker.s.o(.bss);
        build/asm/osGetCount.s.o(.bss);
        build/asm/timerintr.s.o(.bss);
        build/asm/contramwrite.s.o(.bss);
        build/asm/conteepwrite.s.o(.bss);
        build/asm/pfsisplug.s.o(.bss);
        build/asm/crc.s.o(.bss);
        build/asm/getthreadpri.s.o(.bss);
        build/asm/getactivequeue.s.o(.bss);
        build/asm/78BD0.s.o(.bss);
        build/asm/spgetstat.s.o(.bss);
        build/asm/bcopy.s.o(.bss);
        build/asm/writebackdcache.s.o(.bss);
        build/asm/spsetstat.s.o(.bss);
        build/asm/spsetpc.s.o(.bss);
        build/asm/sprawdma.s.o(.bss);
        build/asm/sp.s.o(.bss);
        build/asm/osDpDeviceBusy.s.o(.bss);
        build/asm/setsr.s.o(.bss);
        build/asm/getsr.s.o(.bss);
        build/asm/setfpccsr.s.o(.bss);
        build/asm/sprawread.s.o(.bss);
        build/asm/sprawwrite.s.o(.bss);
        build/asm/invalicache.s.o(.bss);
        build/asm/maptlbrdb.s.o(.bss);
        build/asm/pirawread.s.o(.bss);
        build/asm/cartrominit.s.o(.bss);
        build/asm/leodiskinit.s.o(.bss);
        build/asm/79840.s.o(.bss);
        build/asm/pirawdma.s.o(.bss);
        build/asm/epirawdma.s.o(.bss);
        build/asm/devmgr.s.o(.bss);
        build/asm/leointerrupt.s.o(.bss);
        build/asm/destroythread.s.o(.bss);
        build/asm/filter.s.o(.bss);
        build/asm/reverb.s.o(.bss);
        build/asm/si.s.o(.bss);
        build/asm/xlitob.s.o(.bss);
        build/asm/xldtob.s.o(.bss);
        build/asm/setcompare.s.o(.bss);
        build/asm/resetglobalintmask.s.o(.bss);
        build/asm/epirawwrite.s.o(.bss);
        build/asm/epirawread.s.o(.bss);
        build/asm/setglobalintmask.s.o(.bss);
        build/asm/yieldthread.s.o(.bss);
        build/asm/ldiv.s.o(.bss);
        main_BSS_END = .;
        main_BSS_SIZE = ABSOLUTE(main_BSS_END - main_BSS_START);
    }
    __romPos += SIZEOF(.main);
    __romPos = ALIGN(__romPos, 16);
    main_ROM_END = __romPos;
    main_VRAM_END = .;

    data_lzma_ROM_START = __romPos;
    data_lzma_VRAM = ADDR(.data_lzma);
    .data_lzma : AT(data_lzma_ROM_START) SUBALIGN(16)
    {
        data_lzma_DATA_START = .;
        data_lzma_lzma__bin = .;
        build/assets/data.lzma.bin.o(.data);
        data_lzma_DATA_END = .;
        data_lzma_DATA_SIZE = ABSOLUTE(data_lzma_DATA_END - data_lzma_DATA_START);
    }
    __romPos += SIZEOF(.data_lzma);
    data_lzma_ROM_END = __romPos;
    data_lzma_VRAM_END = .;

    /DISCARD/ :
    {
        *(*);
    }
}
